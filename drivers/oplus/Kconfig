## drivers/oplus/Kconfig
```kconfig
#
# oplus's custom devices
#

menu "OPLUS's custom device support"
	depends on !UML

config OPLUS
	bool "OPLUS's custom devices"
	help
	  OPLUS's custom devices

if OPLUS

config OPLUS_FEATURE_OPROJECT
	tristate "config oplus project info for kernel"
	default n
	help
	  define this config to define oplus project

config OPLUS_LCD_MODIFY
	bool "config lcd"
	help
	  define this config for lcd.

config OPLUS_TP_MODIFY
	bool "config tp"
	help
	  define this config for tp.

config OPLUS_CHARGING_MODIFY
	bool "config charging"
	help
	  define this config for charging, battery or usb.

config OPLUS_POWER_MODIFY
	bool "config power"
	help
	  define this config for system power supply.

config OPLUS_DUAL_SYS_COMM_MODIFY
	bool "config dual sys comm"
	help
	  define this config for add the commuction between 8909 and mcu.

config OPLUS_AUDIO_MODIFY
	bool "config audio"
	help
	  define this config for modifying the audio driver.

config OPLUS_WIFI_MODIFY
	bool "config wifi"
	help
	  define this config for modifying the wifi function.

config OPLUS_BT_MODIFY
	bool "config bt"
	help
	  define this config for modifying the bt function.

config OPLUS_NFC_MODIFY
	bool "config nfc"
	help
	  define this config for modifying the nfc function.

config OPLUS_SENSOR_MODIFY
	bool "config sensor"
	help
	  define this config for modifying the sensor function.

config OPLUS_MOTOR_MODIFY
	bool "config motor"
	help
	  define this config for modifying the motor function.

config OPLUS_PRODUCTION_TEST_MODIFY
	bool "config PRODUCTION_TEST"
	help
	  define this config for production line test function.

config OPLUS_GPS_MODIFY
	bool "config gps"
	help
	  define this config for modifying the gps function.

config RECORD_MDMRST
	bool "config record mdmrst"
	help
	  define this config to count the modem restart times.


config OPLUS_COMMON_SOFT
	tristate "config oplus common software"
	help
	  define this config to get project verion from sharemem.
	  Maybe this value is from CDT or dynamic identify by hardware
	  id.

config OPLUS_SHUTDOWN_DETECT
	tristate "OPLUS shutdown hang detect"
	help
	  define this config to init oplus oplus_shutdown_detect.

config REGULATOR_FAN49103
	tristate "Fairchild FAN49103 Regulator"
	depends on I2C
	help
	  This driver supports Fairchild FAN49103 Digitally Programmable
	  TinyBuck Regulator. The FAN49103 is a step-down switching voltage
	  regulator that delivers a digitally programmable output from an
	  input voltage supply of 2.8V to 4V. The output voltage is
	  programmed through an I2C interface.

config OPLUS_POWERINFO_FTM
	bool "powerinfo ftm config"
	default n
	help
	  Select this config to enable powerinfo ftm

config OPLUS_SWITCH
	bool "config oplus switch"
	depends on PROC_FS
	help
	  define this config for oplus switch feature.

config OPLUS_SWD
	bool "config swd"
	help
	  define this config for swd.

source "drivers/oplus/project_info/Kconfig"

source "drivers/oplus/touchscreen/Kconfig"

source "drivers/oplus/feedback/Kconfig"
endif

endmenu
```

## drivers/oplus/touchscreen/Kconfig
```kconfig
# SPDX-License-Identifier: GPL-2.0-only
#
# Touchscreen driver configuration
#
menuconfig INPUT_TOUCHSCREEN
	bool "Touchscreens"
	help
	  Say Y here, and a list of supported touchscreens will be displayed.
	  This option doesn't affect the kernel.

	  If unsure, say Y.

if INPUT_TOUCHSCREEN

source "drivers/oplus/touchscreen/cyttsp5/Kconfig"

source "drivers/oplus/touchscreen/focaltech_touch/Kconfig"

source "drivers/oplus/touchscreen/zinitix/Kconfig"

endif
```

## drivers/oplus/touchscreen/zinitix/Kconfig
```kconfig
config TOUCHSCREEN_ZTX
    bool "Zinitix Touchscreen"
    default n
    help
      Say Y here if you have Focaltech touch panel.
      If unsure, say N.
```
